## Documentation/devicetree/bindings/display/qcom,qpic-fb.txt
```
* QPIC LCD node

Required properties:
- compatible:		"qcom,mdss_qpic"
- reg:			QPIC LCD register address range
- clocks:		must contain core clock and always on clock
- clock-names:		must contain "core" for the core clock and "aon" for the
			always on clock
- dmas:			DMA specifier, consisting of a phandle BAM DMA
			controller node and the channel number to
			be used for LCD. Refer to dma.txt and
			qcom_bam_dma.txt for more details

Example:

qcom_mdss_qpic@7980000 {
	compatible = "qcom,mdss_qpic";
	reg = <0x7980000 0x24000>;
	interrupts = <0 106 0>;
	clocks = <&gcc GCC_QPIC_CLK>, <&gcc GCC_QPIC_AHB_CLK>;
	clock-names = "core", "aon";
	dmas = <&qpic_bam 6>;
};

* QPIC LCD Display Panel

Required properties:
- compatible:		"qcom,mdss-qpic-panel"
- label:		QPIC LCD Panel Name
- qcom,mdss-pan-res:	QPIC LCD Display Panel resolution in x,y
- qcom,mdss-pan-bpp:	QPIC LCD Display Panel bits per pixel
- qcom,refresh_rate:	QPIC LCD Display Panel refresh rate

Example:

qcom_mdss_qpic_panel {
	compatible = "qcom,mdss-qpic-panel";
	label = "qpic lcd panel";
	qcom,mdss-pan-res = <800 480>;
	qcom,mdss-pan-bpp = <18>;
	qcom,refresh_rate = <60>;
	status = "disabled";
};
```

## Documentation/devicetree/bindings/net/qcom-ssdk.txt
```
* Qualcomm Technologies Inc. SSDK Driver.


Required properties:
- compatible: = should be "qcom,ess-switch";
- reg: Base address and size for the ess-switch register space
- switch_access_mode: should be "local bus"

Example:

ess-switch@3a000000 {
	compatible = "qcom,ess-switch";
	reg = <0x3a000000 0x1000000>;
	switch_access_mode = "local bus";
};

Required properties:
- compatible: = should be "qcom,ess-uniphy";
- reg: Base address and size for the ess-uniphy register space
- uniphy_access_mode: should be "local bus"

Example:

ess-uniphy@7a00000 {
	compatible = "qcom,ess-uniphy";
	reg = <0x7a00000 0x30000>;
	uniphy_access_mode = "local bus";
};
```

## drivers/platform/ipq/Kconfig
```kconfig
menu "IPQ specific device drivers"
	depends on ARCH_QCOM

config BOOTCONFIG_PARTITION
	tristate "BOOTCONFIG Partition support"
	help
	  Say Y here if you would like to use hard disks under Linux which
	  were partitioned using MTD/EFI.

endmenu
```
